VERSION ""

NS_ :

BS_:

BU_: ECU1 ECU2

BO_ 256 EngineData: 8 ECU1
 SG_ Speed : 0|16@1+ (0.1,0) [0|250] "km/h" ECU2
 SG_ Gear : 24|4@1+ (1,0) [0|7] "" ECU2

BA_DEF_ SG_ "GenSigStartValue" INT 0 65535;
BA_DEF_DEF_ "GenSigStartValue" 0;
BA_ "GenSigStartValue" SG_ 256 Gear 3;

VAL_ 256 Gear 0 "P" 1 "R" 2 "N" 3 "D" ;
